## boards/shields/Lily58_dongle/Kconfig.defconfig
```kconfig
if SHIELD_LILY58_DONGLE

config ZMK_KEYBOARD_NAME
    default "Lily58"

config ZMK_SPLIT
    default y

config ZMK_SPLIT_ROLE_CENTRAL
    default y

endif
```

## boards/shields/Lily58_dongle/Kconfig.shield
```kconfig
# Copyright (c) 2020 Pete Johanson
# SPDX-License-Identifier: MIT

config SHIELD_LILY58_DONGLE
    def_bool $(shields_list_contains,Lily58_dongle)
```

## boards/shields/nice_view_custom/Kconfig.defconfig
```kconfig
if SHIELD_NICE_VIEW_CUSTOM

config ZMK_DISPLAY
    default y

config LV_USE_LABEL
    default y

config LV_USE_CANVAS
    default y

config LV_USE_IMG
    default y

config LV_FONT_MONTSERRAT_16
    default y

config LV_Z_VDB_SIZE
    default 100

config LV_DPI_DEF
    default 161

config LV_Z_BITS_PER_PIXEL
    default 1

choice LV_COLOR_DEPTH
    default LV_COLOR_DEPTH_1
endchoice

choice ZMK_DISPLAY_WORK_QUEUE
    default ZMK_DISPLAY_WORK_QUEUE_DEDICATED
endchoice

config LV_Z_MEM_POOL_SIZE
    default 4096

endif
```

## config/west.yml
```yaml
manifest:
  remotes:
    - name: zmkfirmware
      url-base: https://github.com/zmkfirmware
  #additional module
  #  - name: petejohanson
  #    url-base: https://github.com/petejohanson
  #  - name: gpeye
  #    url-base: https://github.com/GPeye
  #  - name: mctechnology17
  #    url-base: https://github.com/mctechnology17
  #  - name: kevinpastor
  #    url-base: https://github.com/kevinpastor
  #  - name: m165437
  #    url-base: https://github.com/M165437
  #  - name: s6t
  #    url-base: https://github.com/s6t
  #  - name: infely
  #    url-base: https://github.com/infely
    - name: penguinchat
      url-base: https://github.com/penguinchat
  #  - name: megacopi
  #    url-base: https://github.com/Megacopi
    - name: badjeff
      url-base: https://github.com/badjeff
    - name: nrfconnect
      url-base: https://github.com/nrfconnect
  projects:
    - name: zmk
      remote: zmkfirmware
      revision: v0.3
      import: app/west.yml
    - name: zmk-feature-split-esb
      remote: badjeff
      revision: 1068e7945a9d95c491af0853a89fcf10aeb26d0d # zmk-0.3 branch @ 2026-01-01, pinned for reproducibility
    - name: sdk-nrf
      remote: nrfconnect
      revision: 9b18c09161de579de214c07298a75c97ed20f502 # v2.6.4, zephyr v3.5.99 - matches ZMK v0.3
      path: nrf
    - name: nrfxlib
      remote: nrfconnect
      revision: e66d1733eb759fc86d877b0551b9db27f157edcf # v2.6.4
      repo-path: sdk-nrfxlib
      path: nrfxlib
  #additional module
  #  - name: hammerbeam-slideshow
  #    remote: gpeye
  #    revision: main
  #  - name: zmk-nice-oled
  #    remote: mctechnology17
  #    revision: main
  #  - name: nice-view-elemental
  #    remote: kevinpastor
  #    revision: main
  #  - name: nice-view-gem
  #    remote: m165437
  #    revision: main
  #  - name: zmk-shield-nice-view-cats
  #    remote: s6t
  #    revision: main
  #  - name: nice-view-battery
  #    remote: infely
  #    revision: main
  #  - name: zmk-dongle-screen
  #    remote: penguinchat
  #    revision: Penguinchat-patch-1
    - name: zmk-for-PandaKB.com-
      remote: penguinchat
      revision: PandaKB_Lily58
  #  - name: zmk-nice-view-megacopi
  #    remote: megacopi
  #    revision: main
  self:
    path: config
```
