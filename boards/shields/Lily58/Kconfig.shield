## boards/shields/Lily58/Kconfig.shield
```kconfig
# Copyright (c) 2020 Pete Johanson
# SPDX-License-Identifier: MIT

config SHIELD_LILY58_L
    def_bool $(shields_list_contains,Lily58_L)

config SHIELD_LILY58_R
    def_bool $(shields_list_contains,Lily58_R)
```
